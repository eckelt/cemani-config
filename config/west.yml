## config/west.yml
```yaml
manifest:
  remotes:
    - name: zmkfirmware
      url-base: https://github.com/zmkfirmware
    # - name: m165437
    #   url-base: https://github.com/M165437
    # support nice_oled and nice_epaper
    - name: joelspadin
      url-base: https://github.com/joelspadin
    - name: mctechnology17
      url-base: https://github.com/mctechnology17
  projects:
    - name: zmk
      remote: zmkfirmware
      #  revision: main
      revision: v0.3
      import: app/west.yml
    - name: zmk-helpers
      remote: urob
      revision: v0.3 # Should match ZMK release.
    # - name: nice-view-gem
    #   remote: m165437
    #   revision: main
    - name: zmk-locales
      remote: joelspadin
      revision: main
    # support nice_oled and nice_epaper
    - name: zmk-nice-oled
      remote: mctechnology17
      revision: main
  self:
    path: config
```
